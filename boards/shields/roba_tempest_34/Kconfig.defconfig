## boards/shields/roba_tempest_34/Kconfig.defconfig
```kconfig
if SHIELD_ROBA_TEMPEST_34_LEFT || SHIELD_ROBA_TEMPEST_34_RIGHT

config ZMK_KEYBOARD_NAME
    default "roBa Tempest 34"

config ZMK_SPLIT
    default y

config ZMK_SPLIT_ROLE_CENTRAL
    default y if SHIELD_ROBA_TEMPEST_34_RIGHT

endif
```

## boards/shields/roba_tempest_34/Kconfig.shield
```kconfig
config SHIELD_ROBA_TEMPEST_34_LEFT
    def_bool $(shields_list_contains,roba_tempest_34_left)

config SHIELD_ROBA_TEMPEST_34_RIGHT
    def_bool $(shields_list_contains,roba_tempest_34_right)
```
